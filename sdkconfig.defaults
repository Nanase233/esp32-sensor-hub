## sdkconfig.defaults
```kconfig
# ESP32-S3-EYE 基础配置
CONFIG_IDF_TARGET="esp32s3"

# I2C 相关配置
CONFIG_ESP_SYSTEM_EVENT_TASK_STACK_SIZE=4096

# 日志级别（调试阶段使用 INFO，发布时可改为 WARN）
CONFIG_LOG_DEFAULT_LEVEL_INFO=y
CONFIG_LOG_DEFAULT_LEVEL=3

# WiFi 配置
CONFIG_ESP_WIFI_NVS_ENABLED=y
CONFIG_ESP_WIFI_SOFTAP_SUPPORT=y

# HTTP 客户端
CONFIG_ESP_HTTP_CLIENT_ENABLE_HTTPS=y

# 增加主任务栈大小（WiFi + HTTP 需要更多栈空间）
CONFIG_ESP_MAIN_TASK_STACK_SIZE=8192
```
